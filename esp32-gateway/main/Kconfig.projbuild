## esp32-gateway/main/Kconfig.projbuild
```kconfig
menu "HoxPi Gateway"

    choice HOXPI_BOARD
        prompt "Board"
        default HOXPI_BOARD_OLIMEX_EVB
        config HOXPI_BOARD_OLIMEX_EVB
            bool "Olimex ESP32-EVB (CAN onboard, LAN8710 RMII)"
        config HOXPI_BOARD_WAVESHARE_S3_POE
            bool "Waveshare ESP32-S3-POE-ETH (W5500 SPI, CAN-Transceiver onboard)"
        config HOXPI_BOARD_CUSTOM
            bool "Eigenes Board (Pins unten setzen)"
    endchoice

    config HOXPI_ETH_RMII
        bool "Ethernet ueber internen EMAC (RMII-PHY) statt W5500/SPI"
        default y if HOXPI_BOARD_OLIMEX_EVB
        default n

    config HOXPI_CAN_TX_GPIO
        int "CAN TX GPIO"
        default 5 if HOXPI_BOARD_OLIMEX_EVB
        default 17 if HOXPI_BOARD_WAVESHARE_S3_POE
        default 5
        help
            Olimex ESP32-EVB: TX GPIO5 / RX GPIO35 (MCP2562 onboard). Waveshare S3-POE-ETH:
            Werte VOR dem ersten Flashen mit dem Waveshare-Wiki abgleichen (Vorbelegung ungeprueft).

    config HOXPI_CAN_RX_GPIO
        int "CAN RX GPIO"
        default 35 if HOXPI_BOARD_OLIMEX_EVB
        default 18 if HOXPI_BOARD_WAVESHARE_S3_POE
        default 35

    config HOXPI_POLL_INTERVAL_S
        int "Poll-Intervall WEZ (s) - Default, NVS 'poll_wez' hat Vorrang"
        range 5 3600
        default 30
        help
            Pause zwischen zwei GET-Runden ueber alle WEZ-Register (HoxPi: --poll-interval 30).
            Alle Poll-Werte, die Schreibfreigabe und die Whitelist koennen zur Laufzeit im NVS
            (Namespace "hoxpi") ueberschrieben werden - siehe main/hoval_cfg.h und tools/gen_esp32_nvs.py.

    config HOXPI_POLL_HV_INTERVAL_S
        int "Poll-Intervall HomeVent (s) - Default, NVS 'poll_hv' hat Vorrang"
        range 1 3600
        default 5

    config HOXPI_POLL_DELAY_MS
        int "Sendeabstand zwischen zwei GET-Frames (ms) - Default, NVS 'poll_delay' hat Vorrang"
        range 10 2000
        default 100

    config HOXPI_MODBUS_PORT
        int "Modbus-TCP Port"
        default 502

    config HOXPI_HTTP_PORT
        int "HTTP-Port der Statusseite (/, /status, /config, /register)"
        default 80

    config HOXPI_HTTP_TOKEN
        string "Token fuer schreibende HTTP-Aufrufe (Header X-Token); leer = POST gesperrt"
        default ""
        help
            POST /config (Poll-Werte, Schreibfreigabe, Whitelist -> NVS), POST /config/reset und
            POST /restart verlangen den Header X-Token mit genau diesem Wert. Leer = nur lesen
            (wie das HoxPi-Dashboard ohne Login). Kein TLS - nur im eigenen LAN verwenden.

    config HOXPI_MQTT_URI
        string "MQTT-Broker-URI (leer = MQTT aus), z. B. mqtt://192.168.1.10:1883"
        default ""
        help
            Home-Assistant-Anbindung wie mqtt/hoval_mqtt.py: Sensoren, COP, stale, Kuehl-Wartezustand und
            fuer Whitelist-Register number/select-Entities (hoval/<key>/set -> CAN ueber denselben
            Pruefpfad wie Modbus). Auto-Discovery unter homeassistant/<art>/hoxpi/<key>/config.
            Achtung: dieselbe Geraetekennung "hoxpi" wie der Raspberry-HoxPi - nicht parallel betreiben.

    config HOXPI_MQTT_USER
        string "MQTT-Benutzer (leer = ohne Anmeldung)"
        default ""

    config HOXPI_MQTT_PASS
        string "MQTT-Passwort"
        default ""

    config HOXPI_MQTT_INTERVAL_S
        int "MQTT-Publikationsintervall (s)"
        range 5 3600
        default 30

    config HOXPI_MQTT_STALE_MIN
        int "MQTT stale-Alarm nach n Minuten ohne dekodierten Datenpunkt"
        range 1 1440
        default 10

    config HOXPI_OTA_ENABLE
        bool "Firmware-Update per HTTP(S) erlauben (POST /ota, X-Token)"
        default y
        help
            esp_https_ota in die inaktive OTA-Partition (partitions.csv: ota_0/ota_1), danach Neustart.
            Rollback: das neue Image gilt erst als gut, wenn es einen CAN-Datenpunkt dekodiert hat
            (HOXPI_OTA_VALID_AFTER_S); sonst startet der Bootloader die vorige Firmware.
            Braucht CONFIG_BOOTLOADER_APP_ROLLBACK_ENABLE (sdkconfig.defaults).

    config HOXPI_OTA_ALLOW_HTTP
        bool "auch http:// (unverschluesselt) als Update-Quelle zulassen"
        depends on HOXPI_OTA_ENABLE
        default n
        help
            Nur im eigenen LAN (z. B. Image vom HoxPi/Raspberry per python3 -m http.server). Das Image
            selbst wird von der IDF auf Magic/Groesse/SHA geprueft, nicht auf Herkunft.

    config HOXPI_OTA_CERT_BUNDLE
        bool "https: Zertifikate ueber das IDF-Wurzelzertifikat-Buendel pruefen"
        depends on HOXPI_OTA_ENABLE
        default y
        help
            esp_crt_bundle_attach (CONFIG_MBEDTLS_CERTIFICATE_BUNDLE). Aus = https ohne Zertifikatpruefung
            ist NICHT vorgesehen; fuer eigene CAs cert_pem in hoval_ota.c eintragen.

    config HOXPI_OTA_VALID_AFTER_S
        int "Rollback, wenn das neue Image nach n Sekunden keinen CAN-Datenpunkt dekodiert hat"
        depends on HOXPI_OTA_ENABLE
        range 60 3600
        default 600

    config HOXPI_OTA_TIMEOUT_MS
        int "HTTP-Timeout beim Laden des Images (ms)"
        depends on HOXPI_OTA_ENABLE
        range 1000 120000
        default 15000

    config HOXPI_ENABLE_WRITE
        bool "Schreibpfad Modbus -> CAN freigeben (Whitelist, min/max, Kalt-Cache-Schutz)"
        default n
        help
            Entspricht --enable-write bei HoxPi. Nur Register der Whitelist (NVS 'whitelist',
            sonst generierte Liste aus whitelist.json bzw. eingebaute HoxPi-Liste) werden auf den
            Bus geschrieben. NVS 'wr_en' (0/1) hat Vorrang vor diesem Default.

    menu "Ethernet RMII (interner EMAC)"
        depends on HOXPI_ETH_RMII
        config HOXPI_ETH_PHY_ADDR
            int "PHY-Adresse"
            default 0
        config HOXPI_ETH_PHY_RST_GPIO
            int "PHY Reset GPIO (-1 = keiner)"
            default -1
        config HOXPI_ETH_MDC_GPIO
            int "MDC GPIO"
            default 23
        config HOXPI_ETH_MDIO_GPIO
            int "MDIO GPIO"
            default 18
    endmenu

    menu "Ethernet W5500 (SPI)"
        depends on !HOXPI_ETH_RMII
        config HOXPI_W5500_MISO
            int "MISO GPIO"
            default 12
        config HOXPI_W5500_MOSI
            int "MOSI GPIO"
            default 11
        config HOXPI_W5500_SCLK
            int "SCLK GPIO"
            default 13
        config HOXPI_W5500_CS
            int "CS GPIO"
            default 14
        config HOXPI_W5500_INT
            int "INT GPIO"
            default 10
        config HOXPI_W5500_RST
            int "RST GPIO (-1 = keiner)"
            default 9
        help
            Vorbelegung nach Waveshare ESP32-S3-ETH-Beispielen; fuer die POE-ETH-8DI-8DO-Variante
            vor dem Flashen im Wiki/Schaltplan pruefen.
    endmenu
endmenu
```

## esp32-gateway/sdkconfig.defaults
```kconfig
# HoxPi-ESP32 Standardwerte
CONFIG_ETH_USE_ESP32_EMAC=y
CONFIG_ETH_USE_SPI_ETHERNET=y
CONFIG_ETH_SPI_ETHERNET_W5500=y
CONFIG_FMB_COMM_MODE_TCP_EN=y
CONFIG_FMB_TCP_PORT_DEFAULT=502
CONFIG_FMB_TCP_PORT_MAX_CONN=4
CONFIG_FMB_TIMER_PORT_ENABLED=n
CONFIG_ESP_MAIN_TASK_STACK_SIZE=6144
CONFIG_LOG_DEFAULT_LEVEL_INFO=y
# OTA: zwei App-Partitionen + Rollback-Schutz (hoval_ota.c); Bundle fuer https-Updates
CONFIG_PARTITION_TABLE_CUSTOM=y
CONFIG_PARTITION_TABLE_CUSTOM_FILENAME="partitions.csv"
CONFIG_PARTITION_TABLE_OFFSET=0x8000
CONFIG_ESPTOOLPY_FLASHSIZE_4MB=y
CONFIG_BOOTLOADER_APP_ROLLBACK_ENABLE=y
CONFIG_MBEDTLS_CERTIFICATE_BUNDLE=y
CONFIG_ESP_HTTPS_OTA_ALLOW_HTTP=y
```
